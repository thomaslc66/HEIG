## SYE_Labo5/so3/Kconfig
```kconfig
mainmenu "SO3 Configuration"

menu "General"
	config CROSS_COMPILE
		string "Cross-compiler tool prefix"
		default "arm-linux-gnueabihf-"
endmenu

 
source "arch/arm/Kconfig"
 
source "drivers/Kconfig" 

source "apps/Kconfig"

source "fs/Kconfig"
source "ipc/Kconfig"
 

config MMU
	bool "MMU enable"
	
config DEBUG_PRINTK
	bool "Debug printk"
	
	
menu "Generated files"
	config ELF
		bool "Generate ELF"
		default y
	config BIN
		bool "Generate BIN"
		default y
		depends on ELF
	config ITB
		bool "Generate ITB"
		default y
		depends on STANDALONE 
		depends on BIN
endmenu
```

## SYE_Labo5/so3/apps/Kconfig
```kconfig
choice
	prompt "SO3 init execution mode :"

	config THREAD_ENV
    	bool "Thread mode (no process)"
    	select APP_DEFAULT
    	
    config PROC_ENV
        bool "Process mode (looking for a init proc like a shell"
        depends on MMU
            

endchoice

menu "SO3 Applications"

	config APP_TEST_MALLOC
		bool "malloc() stress test application"
	
	config APP_DEFAULT
		bool "Default application with thread environment"
	
endmenu
```

## SYE_Labo5/so3/arch/arm/Kconfig
```kconfig
menu "Platform"

choice
	prompt "SO3 OS type"

config STANDALONE
        bool "Standalone OS"
        
endchoice



choice
  prompt "Target"
       	depends on STANDALONE
	config VEXPRESS
    	bool "Vexpress"
   
endchoice

source "arch/arm/vexpress/Kconfig"
source "arch/arm/devices/Kconfig"

source "mm/Kconfig"

endmenu
```

## SYE_Labo5/so3/arch/arm/vexpress/vexpress.its
```
/*
 * U-boot its file definition for Sootech MERIDA board
 * (c) 2016,2017 Sootech SA
 */

/dts-v1/;

/ {
	description = "SO3 image containing so3 kernel and FDT blob";
	#address-cells = <0>;
	#size-cells = <0>;
	
	images {
		#address-cells = <0>;
		#size-cells = <0>;
		kernel {
			/*reg = <>; Make dtc happy ;-) */
			description = "SO3 OS kernel";
			data = /incbin/("../../../so3.bin");
			type = "kernel";
			arch = "arm";
			os = "linux";
			compression = "none";
			load = <0x80008000>;
			entry = <0x80008000>;
			
			#address-cells = <0>;
			#size-cells = <0>;
			
			hash {
				algo = "crc32";
			};
		};
		fdt {
			description = "Flattened Device Tree blob";
			data = /incbin/("../boot/dts/vexpress.dtb");
			type = "flat_dt";
			arch = "arm";
			compression = "none";
			hash {
				algo = "crc32";
			};
		};
	};

	configurations {
		default = "conf";
		conf {
			description = "SO3 kernel image including device tree";
			kernel = "kernel";
			fdt = "fdt";
		};
	};
};
```

## SYE_Labo5/so3/drivers/Kconfig
```kconfig
menu "Drivers"

config UART
	bool "Driver UART"

config TIMER
	bool "Driver Timer"
		
config SPI
	bool "Driver SPI"

config I2C
	bool "Driver I2C"

source "drivers/mmc/Kconfig"

endmenu
```

## SYE_Labo5/so3/fs/Kconfig
```kconfig
menu "Filesystems"

config FS_FAT
        bool "FAT Filesystem"

endmenu
        
```
